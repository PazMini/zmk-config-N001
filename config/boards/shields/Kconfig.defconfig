## config/boards/shields/Kconfig.defconfig
```kconfig
if SHIELD_CALDERA_LEFT

config ZMK_KEYBOARD_NAME
    default "ErgoKeys"

config ZMK_SPLIT_ROLE_CENTRAL
    default y

endif

if SHIELD_ErgoKeys_LEFT || SHIELD_ErgoKeys_RIGHT

config ZMK_SPLIT
    default y

endif
```

## config/boards/shields/Kconfig.shield
```kconfig
config SHIELD_CALDERA_LEFT
    def_bool $(shields_list_contains,ErgoKeys_left)

config SHIELD_CALDERA_RIGHT
    def_bool $(shields_list_contains,ErgoKeys_right)
```
